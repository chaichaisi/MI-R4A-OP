reserved-memory {
            #address-cells = <2>;
            #size-cells = <2>;
            ranges;

            drm_logo: drm-logo@00000000 {
                    compatible = "rockchip,drm-logo";
                    reg = <0x0 0x0 0x0 0x0>;
            };

            ramoops_mem: region@110000 {
                    reg = <0x0 0x110000 0x0 0xf0000>;
                    reg-names = "ramoops_mem";
            };
    };
    
 ramoops: ramoops {
                compatible = "ramoops";
                record-size = <0x0 0x40000>;
                console-size = <0x0 0x80000>;
                ftrace-size = <0x0 0x00000>;
                pmsg-size = <0x0 0x00000>;
                memory-region = <&ramoops_mem>;
        };
